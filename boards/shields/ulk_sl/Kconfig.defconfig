## boards/shields/ulk_sl/Kconfig.defconfig
```kconfig
config ZMK_BLE
	default y




config ZMK_KEYBOARD_NAME
	default "ULK_sl"




if SHIELD_ULK_SL_LEFT

config ZMK_SPLIT
	default y

config ZMK_SPLIT_BLE_ROLE_CENTRAL
	default y

endif

if SHIELD_ULK_SL_RIGHT
config ZMK_SPLIT
	default y

endif
```

## boards/shields/ulk_sl/Kconfig.shield
```kconfig
config SHIELD_ULK_SL_LEFT
    def_bool $(shields_list_contains,ulk_sl_left)

config SHIELD_ULK_SL_RIGHT
    def_bool $(shields_list_contains,ulk_sl_right)
```
